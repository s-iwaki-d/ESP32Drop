/* Real on-air MIFs, captured (-DMIF_HEX) from the firmware as
 * it was at the time -- an OLDER build than the current one (its service_response TXT
 * still reads flags=111611, the garbage value that flags=1019 replaced, and its TLV
 * lengths differ by 2 accordingly). That is exactly what makes them useful: they are
 * frames this code did not produce, so parsing them tests the DECODER rather than the
 * encoder.
 *
 * Source: the MIFHEX lines of testdata/trace3.txt.
 *
 * Of its 111 MIFHEX lines only 80 carry a complete frame; the other 31 (27%) are
 * truncated or have another line's output interleaved into them -- MIFHEX was an
 * ~800-character print issued from the frame path, and the main source of interleaved
 * serial output. Only complete
 * lines are used here: a spliced fixture looks exactly like a decoder bug.
 */
  { 403,
    "d0000000ffffffffffff2a848543b30c002500ff947300007f0017f208100300"
    "1294280112942801044900060000060010006e000018100010000e0003030303"
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    "000000ce111bff0000101000030c326138343835343362333063c00c0c0f0024"
    "8f58300001002a848543b30c00001502009301" },
  { 403,
    "d0000000ffffffffffff2a848543b30c002500ff947300007f0017f208100300"
    "b89f4808b89f4808044900060000060010006e000018100010000d0003030303"
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    "000000ce111bff0000101000030c326138343835343362333063c00c0c0f0024"
    "8f58300001002a848543b30c00001502009301" },
  { 403,
    "d0000000ffffffffffff2a848543b30c002500ff947300007f0017f208100300"
    "4faf080f4faf080f044900060000060010006e000018100010000b0003030303"
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    "000000ce111bff0000101000030c326138343835343362333063c00c0c0f0024"
    "8f58300001002a848543b30c00001502009301" },
